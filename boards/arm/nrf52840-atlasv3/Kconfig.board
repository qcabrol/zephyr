## boards/arm/nrf52840-atlasv3/Kconfig.board
```kconfig
# Kconfig - AELER ATLASV3 board configuration
#
# Copyright (c) 2019 AELER Technologies SA
#
# SPDX-License-Identifier: Apache-2.0

config  BOARD_NRF52840_ATLASV3
	bool "AELER ATLASV3"
	depends on SOC_NRF52840_QIAA
```

## boards/arm/nrf52840-nina-b3/Kconfig
```kconfig
# Kconfig - AELER NINAB3 board configuration
#
# Copyright (c) 2019 AELER Technologies SA
#
# SPDX-License-Identifier: Apache-2.0

if BOARD_NRF52840_NINAB3

config BOARD_ENABLE_DCDC
        bool "Enable DCDC mode"
        select SOC_DCDC_NRF52X
        default y

endif # BOARD_NRF52840_NINAB3
```

## boards/arm/nrf52840-nina-b3/Kconfig.board
```kconfig
# Kconfig - AELER NINAB3 board configuration
#
# Copyright (c) 2019 AELER Technologies SA
#
# SPDX-License-Identifier: Apache-2.0

config  BOARD_NRF52840_NINAB3
	bool "AELER NINAB3"
	depends on SOC_NRF52840_QIAA
```

## boards/arm/nrf52840-nina-b3/Kconfig.defconfig
```kconfig
# Kconfig - AELER NINAB3 board configuration
#
# Copyright (c) 2019 AELER Technologies SA
#
# SPDX-License-Identifier: Apache-2.0

if BOARD_NRF52840_NINAB3

config BOARD
	default "nrf52840_aeler_nina_b3"

if USB

config USB_NRF52840
	default y

config USB_DEVICE_STACK
	default y

endif # USB

if IEEE802154

config IEEE802154_NRF5
	default y

endif # IEEE802154

config BT_CTLR
	default BT

endif # BOARD_NRF52840_NINAB3
```
